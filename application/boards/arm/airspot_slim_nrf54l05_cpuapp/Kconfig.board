## application/boards/arm/airspot_slim_nrf54l05_cpuapp/Kconfig.board
```kconfig
# Copyright (c) 2025 AirSpot
# SPDX-License-Identifier: Apache-2.0

config BOARD_AIRSPOT_SLIM_NRF54L05_CPUAPP
	bool "AirSpot Slim nRF54L05 Application MCU"
	depends on SOC_NRF54L05_CPUAPP
	select SOC_NRF54L05_CPUAPP
```

## application/boards/arm/airspot_slim_nrf54l05_cpuapp/Kconfig.defconfig
```kconfig
# Copyright (c) 2025 AirSpot
# SPDX-License-Identifier: Apache-2.0

if BOARD_AIRSPOT_SLIM_NRF54L05_CPUAPP

config BOARD
	default "airspot_slim_nrf54l05_cpuapp"

endif # BOARD_AIRSPOT_SLIM_NRF54L05_CPUAPP
```

## application/boards/arm/airspot_slim_nrf54l05_cpuapp/airspot_slim_nrf54l05_cpuapp_defconfig
```kconfig
# Copyright (c) 2025 AirSpot
# SPDX-License-Identifier: Apache-2.0

# Enable UART driver
CONFIG_SERIAL=y

# Enable console
CONFIG_CONSOLE=y
CONFIG_UART_CONSOLE=y

# Enable GPIO
CONFIG_GPIO=y

# Enable MPU
CONFIG_ARM_MPU=y

# Enable LED driver
CONFIG_LED=y

# Enable button driver
CONFIG_INPUT=y
CONFIG_INPUT_GPIO=y

# Enable BLE
CONFIG_BT=y
CONFIG_BT_PERIPHERAL=y
CONFIG_BT_DEVICE_NAME="AirSpot Slim"
```

## application/boards/arm/airspot_slim_nrf54l05_cpuapp/board.yml
```yaml
board:
  name: airspot_slim_nrf54l05_cpuapp
  full_name: AirSpot Slim nRF54L05
  vendor: airspot
  socs:
    - name: nrf54l05
      variants:
        - name: cpuapp
          cpucluster: cpu0
```
